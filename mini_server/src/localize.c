#include "localize.h"
#include "ekf.h"
#include "socket.h"
#include <pthread.h>
#include "sys_config.h"
// External EKF state for getting current theta
extern ekf_t g_ekf;
extern pthread_mutex_t g_ekf_mutex;

// ============================================================
// UWB SENSOR OFFSET (translation only)
// Sensor UWB đặt tại vị trí khác nhau trên robot1 và robot2
// ============================================================
#if ROBOT_ID == 1
// Robot1 parameters
#define UWB_OFFSET_X (0.05f)  // -6cm theo trục X
#define UWB_OFFSET_Y (-0.10f) // -7cm theo trục Y
#elif ROBOT_ID == 2
// Robot2 parameters (TODO: Cập nhật tham số thực tế cho robot2)
#define UWB_OFFSET_X (0.07f)  // Tạm thời dùng giống robot1
#define UWB_OFFSET_Y (-0.12f) // Tạm thời dùng giống robot1
#else
#error "ROBOT_ID must be 1 or 2"
#endif

static Coordinates previous = {0};

// ============================================================
// RBF WARPING PARAMETERS (Robot-specific, Generated by Transform_RBF.py)
// ============================================================

#define NUM_ANCHORS 11

#if ROBOT_ID == 1
// ========== ROBOT1 RBF PARAMETERS ==========

// static const float affine_ax = 1.0247526823f;
// static const float affine_bx = -0.0385465836f;
// static const float affine_cx = 0.0697083615f;
// static const float affine_ay = -0.0320153662f;
// static const float affine_by = 1.0182124655f;
// static const float affine_cy = 0.0598352960f;

static const float affine_ax = 0.9858869529f;
static const float affine_bx = -0.0247680941f;
static const float affine_cx = 0.2156408367f;
static const float affine_ay = -0.0176317344f;
static const float affine_by = 0.9944035755f;
static const float affine_cy = 0.0376648198f;

#elif ROBOT_ID == 2
// ========== ROBOT2 RBF PARAMETERS ==========

static const float affine_ax = 0.9889940766f;
static const float affine_bx = -0.0302925736f;
static const float affine_cx = 0.2044782151f;
static const float affine_ay = -0.0125001927f;
static const float affine_by = 1.0056069497f;
static const float affine_cy = -0.0134010061f;

#else
#error "ROBOT_ID must be 1 or 2"
#endif

// ============================================================

DWMDevice *dwm_init(const char *port, int baudrate, int timeout)
{
  DWMDevice *device = (DWMDevice *)malloc(sizeof(DWMDevice));
  if (!device)
  {
    perror("[ERROR] Failed to allocate memory for device");
    return NULL;
  }

  device->port = strdup(port);
  device->baudrate = baudrate;
  device->timeout = timeout;
  device->serial_fd = -1;

  return device;
}

// Open connection to the device
bool dwm_open(DWMDevice *device)
{
  device->serial_fd = open(device->port, O_RDWR | O_NOCTTY);
  if (device->serial_fd < 0)
  {
    fprintf(stderr, "[ERROR] Failed to open port %s: %s\n", device->port,
            strerror(errno));
    return false;
  }

  struct termios tty;
  memset(&tty, 0, sizeof(tty));
  if (tcgetattr(device->serial_fd, &tty) != 0)
  {
    fprintf(stderr, "[ERROR] Failed to get terminal attributes: %s\n",
            strerror(errno));
    close(device->serial_fd);
    device->serial_fd = -1;
    return false;
  }

  // Set baudrate
  cfsetospeed(&tty, device->baudrate);
  cfsetispeed(&tty, device->baudrate);

  // Raw mode
  cfmakeraw(&tty);

  // Set timeout
  tty.c_cc[VMIN] = 0;
  tty.c_cc[VTIME] = device->timeout * 10; // Convert to deciseconds

  if (tcsetattr(device->serial_fd, TCSANOW, &tty) != 0)
  {
    fprintf(stderr, "[ERROR] Failed to set terminal attributes: %s\n",
            strerror(errno));
    close(device->serial_fd);
    device->serial_fd = -1;
    return false;
  }

  printf("[INFO] Opened port: %s\n", device->port);
  return true;
}

// Close connection to the device
void dwm_close(DWMDevice *device)
{
  if (device->serial_fd >= 0)
  {
    close(device->serial_fd);
    device->serial_fd = -1;
  }
}

// Free device resources
void dwm_free(DWMDevice *device)
{
  if (device)
  {
    if (device->port)
    {
      free(device->port);
    }
    free(device);
  }
}

// Send a TLV command to the device
bool dwm_send_tlv_command(DWMDevice *device, uint8_t cmd_type, uint8_t *data,
                          size_t data_len)
{
  if (device->serial_fd < 0)
  {
    return false;
  }

  // Prepare TLV format
  uint8_t tlv[256]; // Max buffer size
  size_t tlv_len = 0;

  tlv[tlv_len++] = cmd_type;

  if (data && data_len > 0)
  {
    tlv[tlv_len++] = data_len;
    memcpy(&tlv[tlv_len], data, data_len);
    tlv_len += data_len;
  }
  else
  {
    tlv[tlv_len++] = 0; // Length 0
  }
  // printf("[DEBUG] Sending command: Type=0x%02X, Length=%zu\n", cmd_type, data
  // ? data_len : 0);

  // Send command
  ssize_t bytes_written = write(device->serial_fd, tlv, tlv_len);
  if (bytes_written != (ssize_t)tlv_len)
  {
    fprintf(stderr, "[ERROR] Failed to send command: %s\n", strerror(errno));
    return false;
  }
  // printf("[DEBUG] Successfully sent %zd bytes\n", bytes_written);
  // Allow time for device to respond
  usleep(765);
  return true;
}

/**
 * Affine Transform: Biến đổi tọa độ từ hệ DWM sang hệ bản đồ
 * Biến đổi tuyến tính 6 tham số, đơn giản và ổn định
 *
 * Công thức:
 *   x_map = ax*x + bx*y + cx
 *   y_map = ay*x + by*y + cy
 */
void align_position(PositionData *position)
{
  float x = position->coordinates.x;
  float y = position->coordinates.y;

  position->coordinates.x = affine_ax * x + affine_bx * y + affine_cx;
  position->coordinates.y = affine_ay * x + affine_by * y + affine_cy;
}

/**
 * Bù offset sensor UWB để lấy vị trí tâm robot
 * Sensor UWB được gắn cố định trên robot, nên khi robot xoay góc theta,
 * offset cũng xoay theo. Cần chuyển offset từ body frame sang global frame.
 *
 * Công thức:
 *   offset_global = R(theta) * offset_body
 *   p_center = p_sensor - offset_global
 */
void compensate_uwb_offset(PositionData *position)
{
  // Lấy góc theta hiện tại từ EKF
  pthread_mutex_lock(&g_ekf_mutex);
  double theta = g_ekf.x[4]; // theta in radians
  pthread_mutex_unlock(&g_ekf_mutex);

  // Xoay offset từ body frame sang global frame
  // offset_body = (UWB_OFFSET_X, UWB_OFFSET_Y)
  // offset_global = R(theta) * offset_body
  float cos_theta = cosf((float)theta);
  float sin_theta = sinf((float)theta);
  float offset_x_global = UWB_OFFSET_X * cos_theta - UWB_OFFSET_Y * sin_theta;
  float offset_y_global = UWB_OFFSET_X * sin_theta + UWB_OFFSET_Y * cos_theta;

  // Vị trí tâm robot = Vị trí sensor - offset_global
  position->coordinates.x -= offset_x_global;
  position->coordinates.y -= offset_y_global;
}

// Read and parse TLV formatted response
bool dwm_read_tlv_response(DWMDevice *device, PositionData *position)
{
  if (device->serial_fd < 0)
  {
    return false;
  }

  // Initialize position data
  memset(position, 0, sizeof(PositionData));

  uint8_t b;
  bool header_found = false;
  int available;

  // Check how many bytes are available
  ioctl(device->serial_fd, FIONREAD, &available);
  // printf("[DEBUG] Bytes available to read: %d\n", available);
  while (available > 0)
  {
    if (read(device->serial_fd, &b, 1) != 1)
    {
      break;
    }

    if (b == 0x40)
    {
      header_found = true;
      break;
    }

    available--;
  }

  if (!header_found)
  {
    // fprintf(stderr, "[ERROR] TLV response header (0x40) not found\n");
    return false;
  }

  // Parse TLV response
  while (true)
  {
    uint8_t type_val, length_val;

    // Read type
    if (read(device->serial_fd, &type_val, 1) != 1)
    {
      printf("[DEBUG] Failed to read type byte\n");
      break;
    }
    // printf("[DEBUG] Read type: 0x%02X\n", type_val);

    // Read length
    if (read(device->serial_fd, &length_val, 1) != 1)
    {
      printf("[DEBUG] Failed to read length byte\n");
      break;
    }
    // printf("[DEBUG] Read length: %d\n", length_val);

    // Read value
    uint8_t value[256];
    if (length_val > 0)
    {
      // printf("[DEBUG] Attempting to read %d value bytes\n", length_val);
      ssize_t bytes_read = read(device->serial_fd, value, length_val);
      if (bytes_read != length_val)
      {
        printf("[DEBUG] Failed to read all value bytes. Read %zd of %d\n",
               bytes_read, length_val);
        break;
      }

      // Print the raw bytes for debugging
      // printf("[DEBUG] Value bytes: ");
      // for (int i = 0; i < length_val && i < 20; i++)
      // { // Limit to 20 bytes for readability
      //     printf("%02X ", value[i]);
      // }
      // if (length_val > 20)
      //     printf("...");
      // printf("\n");
    }

    // Process based on type
    if (type_val == RESP_POSITION)
    {
      // printf("[DEBUG] Processing POSITION response (0x%02X)\n",
      // RESP_POSITION);
      if (length_val >= 13)
      {
        // 3 coordinates (4 bytes each) + quality (1 byte)
        // Convert position bytes to float values (typically in mm)
        int32_t x_mm, y_mm, z_mm;

        // Debug the memory copy operations
        // printf("[DEBUG] Copying bytes for position data\n");

        memcpy(&x_mm, &value[0], 4);
        // printf("[DEBUG] X bytes: %02X %02X %02X %02X -> %d mm\n",
        //        value[0], value[1], value[2], value[3], x_mm);

        memcpy(&y_mm, &value[4], 4);
        // printf("[DEBUG] Y bytes: %02X %02X %02X %02X -> %d mm\n",
        //        value[4], value[5], value[6], value[7], y_mm);

        memcpy(&z_mm, &value[8], 4);
        // printf("[DEBUG] Z bytes: %02X %02X %02X %02X -> %d mm\n",
        //        value[8], value[9], value[10], value[11], z_mm);

        position->coordinates.x = x_mm / 1000.0f; // Convert to meters
        position->coordinates.y = y_mm / 1000.0f;
        position->coordinates.z = z_mm / 1000.0f;
        position->quality = value[12];
        position->has_coordinates = true;

        align_position(position);        // RBF Warping
        compensate_uwb_offset(position); // Bù offset sensor UWB

        // printf("[DEBUG] Successfully parsed position: X=%.3fm, Y=%.3fm,
        // Z=%.3fm, Quality=%d\n",
        //        position->coordinates.x, position->coordinates.y,
        //        position->coordinates.z, position->quality);
      }
      else
      {
        printf("[DEBUG] POSITION response too short: %d bytes (expected ≥13)\n",
               length_val);
      }
    }
    else if (type_val == RESP_ERROR)
    {
      // printf("[DEBUG] Processing ERROR response (0x%02X)\n", RESP_ERROR);
      if (length_val > 0)
      {
        position->error_code = value[0];
        position->has_error = true;
        fprintf(stderr, "[ERROR] Position error code: %d\n",
                position->error_code);
        printf("[DEBUG] Error code: %d\n", position->error_code);
      }
      else
      {
        printf("[DEBUG] ERROR response has no data\n");
      }
    }
    else
    {
      // printf("[DEBUG] Unknown response type: 0x%02X\n", type_val);
    }

    // Check if we need to read more
    ioctl(device->serial_fd, FIONREAD, &available);
    // printf("[DEBUG] Bytes remaining to read: %d\n", available);
    if (available <= 0)
      break;
  }

  // printf("[DEBUG] TLV parsing complete. Has coordinates: %d, Has error:
  // %d\n",
  //        position->has_coordinates, position->has_error);
  return position->has_coordinates || position->has_error;
}

// Get current position data from the device
bool dwm_get_position(DWMDevice *device, PositionData *position)
{
  if (!dwm_send_tlv_command(device, CMD_GET_POSITION, NULL, 0))
  {
    return false;
  }

  return dwm_read_tlv_response(device, position);
}

// Get current time string
static void get_time_str(char *buffer, size_t size)
{
  time_t now = time(NULL);
  struct tm *tm_info = localtime(&now);
  strftime(buffer, size, "%H:%M:%S", tm_info);
}

// Apply butterworth filter to coordinates
static void apply_butterworth_filter(Coordinates *raw, Coordinates *current)
{
  if (!raw)
    return;
  // y[n] = 0.509525 * y[n-1] + 0.245237 * x[n-0] + 0.245237 * x[n-1]
  current->x = A1 * current->x + B1 * raw->x + B2 * previous.x;
  current->y = A1 * current->y + B1 * raw->y + B2 * previous.y;
  current->z = A1 * current->z + B1 * raw->z + B2 * previous.z;
  previous = *raw;
}

// Stable position for initialization
static pthread_mutex_t g_stable_position_mutex = PTHREAD_MUTEX_INITIALIZER;
static bool g_stable_position_valid = false;
static Coordinates g_stable_position = {0};
static bool g_need_recalculate = true;

// Main function
static pthread_mutex_t g_position_mutex = PTHREAD_MUTEX_INITIALIZER;
static bool g_position_valid = false;
static Coordinates g_current_position = {0};

// Force recalculate stable position (called when new client connects)
void localize_force_recalculate_stable_position(void)
{
  pthread_mutex_lock(&g_stable_position_mutex);
  g_need_recalculate = true;
  g_stable_position_valid = false;
  pthread_mutex_unlock(&g_stable_position_mutex);
  printf("[LOCALIZE] Stable position recalculation requested\n");
}

// Get stable position (wait if needed)
bool localize_get_stable_position(Coordinates *stable_pos)
{
  pthread_mutex_lock(&g_stable_position_mutex);
  if (g_stable_position_valid && !g_need_recalculate)
  {
    *stable_pos = g_stable_position;
    pthread_mutex_unlock(&g_stable_position_mutex);
    return true;
  }
  pthread_mutex_unlock(&g_stable_position_mutex);

  // Need to calculate, wait a bit
  int max_wait = 50; // 5 seconds
  for (int i = 0; i < max_wait; i++)
  {
    usleep(100000); // 100ms
    pthread_mutex_lock(&g_stable_position_mutex);
    if (g_stable_position_valid && !g_need_recalculate)
    {
      *stable_pos = g_stable_position;
      pthread_mutex_unlock(&g_stable_position_mutex);
      return true;
    }
    pthread_mutex_unlock(&g_stable_position_mutex);
  }

  return false;
}

// Calculate stable position (error < 10cm)
static bool calculate_stable_position(DWMDevice *device,
                                      Coordinates *stable_pos)
{
#define MAX_SAMPLES 10
#define ERROR_THRESHOLD 0.10 // 10cm

  Coordinates samples[MAX_SAMPLES];
  int valid_count = 0;

  printf("[LOCALIZE] Calculating stable position...\n");

  // Collect samples
  for (int i = 0; i < MAX_SAMPLES && g_running; i++)
  {
    PositionData pos;
    if (dwm_get_position(device, &pos) && pos.has_coordinates)
    {
      samples[valid_count] = pos.coordinates;
      valid_count++;
      printf("[LOCALIZE] Sample %d: X=%.3f Y=%.3f\n", valid_count,
             pos.coordinates.x, pos.coordinates.y);
    }
    usleep(100000); // 100ms between samples
  }

  if (valid_count < 5)
  {
    printf("[LOCALIZE] Not enough samples (%d/5)\n", valid_count);
    return false;
  }

  // Calculate average
  float avg_x = 0, avg_y = 0;
  for (int i = 0; i < valid_count; i++)
  {
    avg_x += samples[i].x;
    avg_y += samples[i].y;
  }
  avg_x /= valid_count;
  avg_y /= valid_count;

  // Check error
  float max_error = 0;
  for (int i = 0; i < valid_count; i++)
  {
    float dx = samples[i].x - avg_x;
    float dy = samples[i].y - avg_y;
    float error = sqrtf(dx * dx + dy * dy);
    if (error > max_error)
      max_error = error;
  }

  printf("[LOCALIZE] Average position: X=%.3f Y=%.3f, Max error: %.3f m\n",
         avg_x, avg_y, max_error);

  if (max_error > ERROR_THRESHOLD)
  {
    printf("[LOCALIZE] Error too large (%.3f > %.3f), retrying...\n", max_error,
           ERROR_THRESHOLD);
    return false;
  }

  stable_pos->x = avg_x;
  stable_pos->y = avg_y;
  stable_pos->z = 0;

  printf("[LOCALIZE] Stable position found: X=%.3f Y=%.3f\n", avg_x, avg_y);
  return true;
}

void *localize_thread(void *arg)
{

  // Use command line argument for port if provided, otherwise suggest common
  // Raspberry Pi ports
  const char *port;

  if (arg != NULL)
  {
    port = (const char *)arg;
  }
  else
  {
    printf("[INFO] No port specified. Common ports on Raspberry Pi:\n");
    printf("       - /dev/ttyACM0 (most common for USB devices)\n");
    printf("       - /dev/ttyUSB0 (for USB-to-Serial adapters)\n");
    printf("       - /dev/ttyAMA0 (for GPIO serial port)\n");
    printf("[INFO] Using /dev/ttyACM0 as default.\n");
    printf("[INFO] To specify a different port, run: %s /dev/ttyXXX\n",
           (const char *)arg);
    port = "/dev/ttyACM0";
  }

  printf("[INFO] Starting continuous position reading on port %s. Press Ctrl+C "
         "to exit.\n",
         port);

  // Initialize device
  DWMDevice *device = dwm_init(port, DEFAULT_BAUDRATE, DEFAULT_TIMEOUT);
  if (!device)
  {
    fprintf(stderr, "[ERROR] Failed to initialize device\n");
    return NULL;
  }

  // Open device
  if (!dwm_open(device))
  {
    dwm_free(device);
    return NULL;
  }

  Coordinates current_position = {0};

  // Main loop to continuously read position
  while (g_running)
  {
    // Check if need to calculate stable position
    pthread_mutex_lock(&g_stable_position_mutex);
    bool need_calc = g_need_recalculate;
    pthread_mutex_unlock(&g_stable_position_mutex);

    if (need_calc)
    {
      Coordinates stable;
      if (calculate_stable_position(device, &stable))
      {
        pthread_mutex_lock(&g_stable_position_mutex);
        g_stable_position = stable;
        g_stable_position_valid = true;
        g_need_recalculate = false;
        pthread_mutex_unlock(&g_stable_position_mutex);
        printf("[LOCALIZE] Stable position ready for clients\n");
      }
      else
      {
        printf("[LOCALIZE] Failed to get stable position, retrying...\n");
        usleep(500000); // Wait 500ms before retry
        continue;
      }
    }

    PositionData Rawposition;

    if (dwm_get_position(device, &Rawposition))
    {
      char time_str[9]; // HH:MM:SS + null terminator
      get_time_str(time_str, sizeof(time_str));
      if (Rawposition.has_coordinates)
      {
        apply_butterworth_filter(&Rawposition.coordinates, &current_position);
        // Update global position
        pthread_mutex_lock(&g_position_mutex);
        g_current_position = current_position;
        g_position_valid = true;
        pthread_mutex_unlock(&g_position_mutex);
        //
        cJSON *json = cJSON_CreateObject();
        cJSON_AddStringToObject(json, "id", "robot1");
        cJSON_AddStringToObject(json, "type", "position");
        cJSON_AddStringToObject(json, "source", "localization");
        cJSON *data = cJSON_CreateObject();
        cJSON *position = cJSON_CreateArray();
        cJSON_AddItemToArray(position, cJSON_CreateNumber(current_position.x));
        cJSON_AddItemToArray(position, cJSON_CreateNumber(current_position.y));
        // cJSON_AddItemToArray(position,
        // cJSON_CreateNumber(current_position.z));
        cJSON_AddItemToArray(position, cJSON_CreateNumber(Rawposition.quality));
        cJSON_AddItemToObject(data, "position", position);
        cJSON_AddItemToObject(json, "data", data);
        char *json_str = cJSON_PrintUnformatted(json);
        size_t json_len = strlen(json_str);
        char *json_with_nl = malloc(json_len + 2);
        sprintf(json_with_nl, "%s\n", json_str);

        json_handler_add_message(json_with_nl, json_len + 1);
        send_to_upstream_server(json_with_nl, json_len + 1);

        free(json_with_nl);
        free(json_str);
        cJSON_Delete(json);
        // printf("[%s] Position: X=%.3fm, Y=%.3fm, Z=%.3fm (Quality: %d)\n",
        //        time_str,
        //        current_position.x,
        //        current_position.y,
        //        current_position.z,
        //        Rawposition.quality);
      }
      else
      {
        printf("[%s] Could not read position\n", time_str);
      }
    }
    else
    {
      char time_str[9]; // HH:MM:SS + null terminator
      get_time_str(time_str, sizeof(time_str));
      printf("[%s] Could not read position\n", time_str);
    }

    // Delay before next read
    usleep(UPDATE_INTERVAL);
  }

  // Clean up
  dwm_close(device);
  dwm_free(device);

  return NULL;
}
